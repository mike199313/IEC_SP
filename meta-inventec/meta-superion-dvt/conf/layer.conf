## meta-inventec/meta-superion-dvt/conf/layer.conf
```bitbake
# We have a conf and classes directory, add to BBPATH
BBPATH .= ":${LAYERDIR}"

# We have recipes-* directories, add to BBFILES
BBFILES += "${LAYERDIR}/recipes-*/*/*.bb \
            ${LAYERDIR}/recipes-*/*/*.bbappend \
            ${LAYERDIR}/meta-superion/recipes-*/*/*.bb \
            ${LAYERDIR}/meta-superion/recipes-*/*/*.bbappend"

BBFILE_COLLECTIONS += "superion-dvt"
BBFILE_PATTERN_superion-dvt = "^${LAYERDIR}/"
BBFILE_PRIORITY_superion-dvt = "8"
LAYERSERIES_COMPAT_superion-dvt = "honister kirkstone"
```

## meta-inventec/meta-superion-nuv/conf/layer.conf
```bitbake
# We have a conf and classes directory, add to BBPATH
BBPATH .= ":${LAYERDIR}"

# We have recipes-* directories, add to BBFILES
BBFILES += "${LAYERDIR}/recipes-*/*/*.bb \
            ${LAYERDIR}/recipes-*/*/*.bbappend"

BBFILE_COLLECTIONS += "superion-nuv"
BBFILE_PATTERN_superion-nuv = "^${LAYERDIR}/"
BBFILE_PRIORITY_superion-nuv = "7"
LAYERSERIES_COMPAT_superion-nuv = "honister kirkstone"
```

## meta-inventec/meta-superion-nuv/conf/machine/superion-nuv.conf
```bitbake
require conf/machine/include/npcm7xx.inc
require conf/machine/include/obmc-bsp-common.inc
require conf/machine/include/inventec.inc

KMACHINE = "nuvoton"
KERNEL_DEVICETREE = "${KMACHINE}-npcm750-buv-runbmc.dtb"

FLASH_SIZE = "67712"
FLASH_UBOOT_SPL_SIZE = "64"
FLASH_KERNEL_OFFSET = "21632"
FLASH_ROFS_OFFSET = "30848"
FLASH_RWFS_OFFSET = "3200"

# PFR settings
# The size of raw binary image. The value of PFR_IMAGE_SIZE is usally the size of BMC
# firmware flash. PFM image, BMC firmware, and signed capsule will be stored in the raw
# binary image according to the partition offset.
PFR_IMAGE_SIZE = "262144"

# PFM_OFFSET_PAGE The start offset of PFM in BMC flash for storing PFM (Platform firmware
# manifest) binary
# 0x000E0000
PFM_OFFSET_PAGE = "896"

# The start offset of recovery image for storing signed recovery capsule.
# 0x04220000
RC_IMAGE_PAGE = "67712"

# The file name of pfr manifest file. The file includes protection information of each flash
# partition, and whitelist commands of i2c buses.
PFR_MANIFEST = "pfr_manifest_ast2600_superion.json"

# The parameter tells signing utility the signing algorithm of root keys
# 1 = SHA256, 2 = SHA384
PFR_SHA = "2"

# PFR image build major version, range is 0 - 255
PFR_BUILD_VER_MAJ = "0"

# PFR image build major version, range is 0 - 255
PFR_BUILD_VER_MIN = "2"


UBOOT_MACHINE = "PolegRunBMC_defconfig"
UBOOT_DEVICETREE = "nuvoton-npcm750-buv"
IGPS_MACHINE = "RunBMC"

IMAGE_FSTYPES += " cpio.${INITRAMFS_CTYPE}.u-boot"
KERNEL_ALT_IMAGETYPE = "vmlinux"


MACHINE_FEATURES += "ext2"

DISTRO_FEATURES:remove = "avahi"
DISTRO_FEATURES:remove = "slp"

IMAGE_FEATURES:remove = "obmc-fan-control"


# If set to boolean true ('yes', 'y', 'true', 't', '1'), /var/log links to /var/volatile/log.
# If set to boolean false ('no', 'n', 'false', 'f', '0'), /var/log is on persistent storage.
VOLATILE_LOG_DIR = "false"


# PREFERRED_PROVIDER_virtual/phosphor-ipmi-fru-inventory = "superion-nuv-ipmi-fru-inventory-native"
# PREFERRED_PROVIDER_virtual/phosphor-ipmi-fru-read-inventory = "superion-nuv-ipmi-fru-read-inventory-native"
# PREFERRED_PROVIDER_virtual/phosphor-ipmi-fru-properties = "superion-nuv-ipmi-fru-properties-native"
# PREFERRED_PROVIDER_virtual/phosphor-led-manager-config-native = "superion-nuv-led-manager-config-native"
```
